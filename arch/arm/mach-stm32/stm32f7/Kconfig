## arch/arm/mach-stm32/stm32f7/Kconfig
```kconfig
if STM32F7

config TARGET_STM32F746_DISCO
	bool "STM32F746 Discovery board"
	
config TARGET_STM32F769_DISCO
	bool "STM32F769 Discovery board"

source "board/st/stm32f746-disco/Kconfig"
source "board/st/stm32f769-disco/Kconfig"

endif
```
